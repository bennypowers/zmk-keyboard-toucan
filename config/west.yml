## config/west.yml
```yaml
manifest:
  defaults:
    revision: v0.3
  remotes:
    - name: zmkfirmware
      url-base: https://github.com/zmkfirmware
    - name: petejohanson
      url-base: https://github.com/petejohanson/
    - name: caksoylar
      url-base: https://github.com/caksoylar
    - name: geeksville
      url-base: https://github.com/geeksville
    - name: bennypowers
      url-base: https://github.com/bennypowers
    - name: halfdane
      url-base: https://github.com/halfdane
  projects:
    - name: zmk
      remote: zmkfirmware
      import: app/west.yml
    - name: cirque-input-module
      remote: geeksville
      revision: toucan
    - name: zmk-input-gestures
      remote: bennypowers
      revision: main
    - name: zmk-input-processors
      remote: halfdane
      revision: main
    - name: zmk-rgbled-widget
      remote: caksoylar
      revision: c38c4b4
  self:
    path: config
```
